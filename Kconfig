## Kconfig
```kconfig
# SPDX-License-Identifier: GPL-2.0
menuconfig FB_TFT
	tristate "Support for small TFT LCD display modules"
	depends on FB && SPI
	depends on GPIOLIB || COMPILE_TEST
	select FB_SYS_FILLRECT
	select FB_SYS_COPYAREA
	select FB_SYS_IMAGEBLIT
	select FB_DEFERRED_IO
	select FB_BACKLIGHT

config FB_KEDEI62
	tristate "FB driver for KeDei 6.2"
	depends on FB_TFT
	help
	  Framebuffer support for the KeDei 6.2 TFT display (480x320).
	  Uses three 74HC595 shift registers as a parallel bus converter
	  between SPI and the R61581 LCD controller.
```
